## conf/layer.conf
```bitbake
#
# Copyright (C) 2024 Wind River Systems, Inc.
#

# We have a conf and classes directory, add to BBPATH
BBPATH =. "${LAYERDIR}:"

# We have a packages directory, add to BBFILES
BBFILES += "${LAYERDIR}/recipes-*/*/*.bb \
	${LAYERDIR}/recipes-*/*/*.bbappend \
	${LAYERDIR}/classes/*.bbclass"

BBFILE_COLLECTIONS += "wr-nxp-imx9"
BBFILE_PATTERN_wr-nxp-imx9 := "^${LAYERDIR}/"
BBFILE_PRIORITY_wr-nxp-imx9 = "7"

# This should only be incremented on significant changes that will
# cause compatibility issues with other layers
LAYERVERSION_wr-nxp-imx9 = "1"

WRL_RECIPES:wr-nxp-imx9 += 'pktgen-scripts'

LAYERSERIES_COMPAT_wr-nxp-imx9 = "wrl scarthgap"
LAYERDEPENDS_wr-nxp-imx9 = "core wrlinux freescale-layer freescale-distro fsl-bsp-release fsl-sdk-release meta-ml"
```

## conf/machine/nxp-imx9.conf
```bitbake
#@TYPE: Machine
#@NAME: nxp-imx9
#@DESCRIPTION: nxp-imx9

DEFAULTTUNE = "cortexa55"
require conf/machine/include/arm/armv8-2a/tune-cortexa55.inc

MACHINE_FEATURES = "ext3 pci usbgadget usbhost vfat alsa"

DISTRO_FEATURES:append = " wifi bluetooth pci"

KERNEL_IMAGETYPE = ""
KERNEL_IMAGETYPES = "Image.gz Image"

DTB_FILES = "imx93-11x11-evk.dtb"

KERNEL_DEVICETREE = "${@''.join('freescale/%s ' % d for d in '${DTB_FILES}'.split())}"

SERIAL_CONSOLE = "115200 ttyLF0"
SERIAL_CONSOLES_CHECK ?= "${SERIAL_CONSOLES}"

BSP_NXP_DERIVED:append=" nxp-imx9"

MACHINEOVERRIDES:prepend = "mx93-nxp-bsp:"

OPTEEOS_CONFIG = "imx-mx8qmmek imx-mx8mqevk imx-mx8mpevk imx-mx93evk"

MACHINE_FEATURES:append = " optee"

NON_MULTILIB_RECIPES:append = " optee-os"
NON_MULTILIB_RECIPES:append = " optee-test"
NON_MULTILIB_RECIPES:append = " optee-client"
NON_MULTILIB_RECIPES:append = " optee-os-tadevkit"

MULTILIBS ?= "multilib:lib32"
DEFAULTTUNE:virtclass-multilib-lib32 ?= "armv7athf-neon"

WKS_FILE ?= "sdimage-ubootheader-imx9.wks"
do_image_wic[depends] += "mtools-native:do_populate_sysroot dosfstools-native:do_populate_sysroot"

PREFERRED_PROVIDER_virtual/kernel ??= "linux-yocto"
PREFERRED_VERSION_linux-yocto ?= "6.1%"

MACHINE_EXTRA_RRECOMMENDS = " kernel-modules kernel-devicetree linux-firmware-ath10k linux-firmware-imx-sdma-imx7d"
IMAGE_FSTYPES += "tar.bz2 wic wic.bmap"
IMAGE_INSTALL:append = " kernel-devicetree kernel-image-image"

IMAGE_BOOT_FILES ?= "Image ${DTB_FILES}"

MACHINE_SOCARCH = "nxp_imx9"
```
